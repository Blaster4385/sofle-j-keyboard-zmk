## boards/arm/eyelash_sofle/Kconfig.board
```kconfig
#
# Copyright (c) 2024 The ZMK Contributors
# SPDX-License-Identifier: MIT
#

config BOARD_EYELASH_SOFLE_LEFT
    bool "sofle_custom left"
    depends on SOC_NRF52840_QIAA

config BOARD_EYELASH_SOFLE_RIGHT
    bool "sofle_custom right"
    depends on SOC_NRF52840_QIAA
```

## boards/arm/sofle_custom/Kconfig.board
```kconfig
#
# Copyright (c) 2024 The ZMK Contributors
# SPDX-License-Identifier: MIT
#

config BOARD_SOFLE_CUSTOM_LEFT
    bool "sofle_custom left"
    depends on SOC_NRF52840_QIAA

config BOARD_SOFLE_CUSTOM_RIGHT
    bool "sofle_custom right"
    depends on SOC_NRF52840_QIAA
```
